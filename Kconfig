## Kconfig
```kconfig
mainmenu "NEMU Configuration Menu"

choice
  prompt "Base ISA"
  default ISA_riscv
config ISA_riscv
  bool "riscv"
endchoice

config ISA
  string
  default "riscv32" if ISA_riscv && !RV64
  default "riscv64" if ISA_riscv &&  RV64
  default "none"

config ISA64
  depends on ISA_riscv && RV64
  bool
  default y


if ISA_riscv
source "src/isa/riscv32/Kconfig"
endif

config VERILATOR_TRACE
  bool "Enable Verilator VCD waveform trace"
  default y
  help
    Generate VCD waveform file for debugging.
    Output: build/npc_core.vcd


choice
  prompt "Build target"
  default TARGET_NATIVE_ELF
config TARGET_NATIVE_ELF
  bool "Executable on Linux Native"
config TARGET_SHARE
  bool "Shared object (used as REF for differential testing)"
endchoice

menu "Build Options"
choice
  prompt "Compiler"
  default CC_GCC
config CC_GCC
  bool "gcc"
config CC_GPP
  bool "g++"
config CC_CLANG
  bool "clang"
endchoice

config CC
  string
  default "gcc" if CC_GCC
  default "g++" if CC_GPP
  default "clang" if CC_CLANG
  default "none"

choice
  prompt "Optimization Level"
  default CC_O2
config CC_O0
  bool "O0"
config CC_O1
  bool "O1"
config CC_O2
  bool "O2"
config CC_O3
  bool "O3"
endchoice

config CC_OPT
  string
  default "-O0" if CC_O0
  default "-O1" if CC_O1
  default "-O2" if CC_O2
  default "-O3" if CC_O3
  default "none"

config CC_LTO
  bool "Enable link-time optimization"
  default n

config CC_DEBUG
  bool "Enable debug information"
  default n

config CC_ASAN
  bool "Enable address sanitizer"
  default n
endmenu

# =============================== testing and debugging =============================== #

menu "Testing and Debugging"

config TRACE
  depends on TARGET_NATIVE_ELF
  bool "Enable tracer"
  default y

config TRACE_START
  depends on TRACE
  int "When tracing is enabled (unit: number of instructions)"
  default 0

config TRACE_END
  depends on TRACE
  int "When tracing is disabled (unit: number of instructions)"
  default 10000

config ITRACE
  depends on TRACE && TARGET_NATIVE_ELF
  bool "Enable instruction tracer"
  default y

config ITRACE_COND
  depends on ITRACE
  string "Only trace instructions when the condition is true"
  default "true"

config IRINGBUF_SIZE
  depends on ITRACE
  int "Size of the instruction ring buffer"
  default 16

config FTRACE
  depends on TRACE && TARGET_NATIVE_ELF
  bool "Enable function tracer"
  default n

config FTRACE_STACK_MAX
  depends on FTRACE
  int "Maximum depth of the function call stack"
  default 64

config FTRACE_LOG_SIZE
  depends on FTRACE
  int "Size of the function call log buffer"
  default 512

config MTRACE
  depends on TRACE && TARGET_NATIVE_ELF
  bool "Enable memory tracer"
  default y

config MTRACE_COND
  depends on MTRACE
  string "Only trace memory when the condition is true"
  default "true"

config DTRACE
  depends on TRACE && TARGET_NATIVE_ELF
  bool "Enable device tracer"
  default y

config ETRACE
  depends on TRACE && TARGET_NATIVE_ELF
  bool "Enable exception tracer"
  default y

config ETRACE_BUF_SIZE
  depends on ETRACE
  int "Size of the exception trace buffer"
  default 16

config WATCHPOINT
  bool "Enable watchpoint"
  default y


config DIFFTEST
  depends on TARGET_NATIVE_ELF
  bool "Enable differential testing"
  default n
  help
    Enable differential testing with a reference design.
    Note that this will significantly reduce the performance of NEMU.

endmenu

source "src/memory/Kconfig"
source "src/device/Kconfig"

config RT_CHECK
  bool "Enable runtime checking"
  default y
```
