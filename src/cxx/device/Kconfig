## src/cxx/device/Kconfig
```kconfig
# =============================== SoC Address Map ===============================
# These addresses define the hardware memory map for the SoC.
# Both Chisel (hardware) and C++ (simulation) use these values.

menu "SoC Address Map"

config SOC_RESET_VECTOR
  hex "CPU reset vector address"
  default 0x30000000

config SOC_UART_BASE
  hex "UART base address"
  default 0x10000000

config SOC_UART_SIZE
  hex "UART address space size"
  default 0x1000

config SOC_GPIO_BASE
  hex "GPIO base address"
  default 0x10002000

config SOC_GPIO_SIZE
  hex "GPIO address space size"
  default 0x10

config SOC_KEYBOARD_BASE
  hex "PS2 Keyboard base address"
  default 0x10011000

config SOC_KEYBOARD_SIZE
  hex "PS2 Keyboard address space size"
  default 0x8

config SOC_VGA_BASE
  hex "VGA frame buffer base address"
  default 0x21000000

config SOC_VGA_SIZE
  hex "VGA frame buffer size"
  default 0x200000

config SOC_SPI_CTRL_BASE
  hex "SPI controller base address"
  default 0x10001000

config SOC_SPI_CTRL_SIZE
  hex "SPI controller address space size"
  default 0x1000

config SOC_XIP_FLASH_BASE
  hex "XIP Flash base address"
  default 0x30000000

config SOC_XIP_FLASH_SIZE
  hex "XIP Flash address space size"
  default 0x10000000

config SOC_PSRAM_BASE
  hex "PSRAM base address"
  default 0x80000000

config SOC_PSRAM_SIZE
  hex "PSRAM address space size"
  default 0x400000

config SOC_MROM_BASE
  hex "MROM base address"
  default 0x20000000

config SOC_MROM_SIZE
  hex "MROM address space size"
  default 0x1000

config SOC_SRAM_BASE
  hex "SRAM base address"
  default 0x0f000000

config SOC_SRAM_SIZE
  hex "SRAM address space size"
  default 0x2000

config SOC_SDRAM_BASE
  hex "SDRAM base address"
  default 0xa0000000

config SOC_SDRAM_SIZE
  hex "SDRAM address space size"
  default 0x2000000

endmenu # SoC Address Map

# =============================== Device Configuration ===============================

menuconfig DEVICE
  depends on !TARGET_SHARE
  bool "Devices"
  default n
  help
    Provide device support for NEMU.

if DEVICE

menuconfig HAS_SERIAL
  bool "Enable serial"
  default y

if HAS_SERIAL

config SERIAL_MMIO
  hex "MMIO address of the serial controller"
  default SOC_UART_BASE

config SERIAL_INPUT_FIFO
  bool "Enable input FIFO with /tmp/nemu.serial"
  default n
endif # HAS_SERIAL

menuconfig HAS_TIMER
  bool "Enable timer"
  default y

if HAS_TIMER
config RTC_MMIO
  hex "MMIO address of the timer"
  default 0xa0000048
endif # HAS_TIMER

menuconfig HAS_KEYBOARD
  bool "Enable keyboard"
  default y

if HAS_KEYBOARD
config I8042_DATA_MMIO
  hex "MMIO address of the keyboard controller"
  default SOC_KEYBOARD_BASE
endif # HAS_KEYBOARD

menuconfig HAS_VGA
  bool "Enable VGA"
  default y

if HAS_VGA
config FB_ADDR
  hex "Physical address of the VGA frame buffer"
  default SOC_VGA_BASE

config VGA_CTL_MMIO
  hex "MMIO address of the VGA controller"
  default 0xa0000100

config VGA_SHOW_SCREEN
  bool "Enable SDL SCREEN"
  default y

choice
  prompt "Screen Size"
  default VGA_SIZE_400x300
config VGA_SIZE_400x300
  bool "400 x 300"
config VGA_SIZE_800x600
  bool "800 x 600"
endchoice
endif # HAS_VGA

menuconfig HAS_AUDIO
  bool "Enable audio"
  default y

if HAS_AUDIO
config SB_ADDR
  hex "Physical address of the audio stream buffer"
  default 0xa1200000

config SB_SIZE
  hex "Size of the audio stream buffer"
  default 0x10000

config AUDIO_CTL_MMIO
  hex "MMIO address of the audio controller"
  default 0xa0000200
endif # HAS_AUDIO

menuconfig HAS_DISK
  bool "Enable disk"
  default y

if HAS_DISK
config DISK_CTL_MMIO
  hex "MMIO address of the disk controller"
  default 0xa0000300

config DISK_IMG_PATH
  string "The path of disk image"
  default ""
endif # HAS_DISK

menuconfig HAS_SDCARD
  bool "Enable sdcard"
  default n

if HAS_SDCARD
config SDCARD_CTL_MMIO
  hex "MMIO address of the sdcard controller"
  default 0xa3000000

config SDCARD_IMG_PATH
  string "The path of sdcard image"
  default ""
endif # HAS_SDCARD

endif # DEVICE
```

## src/cxx/memory/Kconfig
```kconfig
menu "Memory Configuration"

config PC_RESET_OFFSET
  hex "Offset of reset vector from the base of MROM"
  default 0

config MEM_RANDOM
  depends on !DIFFTEST
  bool "Initialize the SRAM with random values"
  default y
  help
    This may help to find undefined behaviors.

endmenu #MEMORY
```

## src/scala/device/Kconfig
```kconfig
# =============================== SoC Address Map ===============================
# These addresses define the hardware memory map for the SoC.
# Both Chisel (hardware) and C++ (simulation) use these values.

menu "SoC Address Map"

config SOC_RESET_VECTOR
  hex "CPU reset vector address"
  default 0x30000000

config SOC_UART_BASE
  hex "UART base address"
  default 0x10000000

config SOC_UART_SIZE
  hex "UART address space size"
  default 0x1000

config SOC_GPIO_BASE
  hex "GPIO base address"
  default 0x10002000

config SOC_GPIO_SIZE
  hex "GPIO address space size"
  default 0x10

config SOC_KEYBOARD_BASE
  hex "PS2 Keyboard base address"
  default 0x10011000

config SOC_KEYBOARD_SIZE
  hex "PS2 Keyboard address space size"
  default 0x8

config SOC_VGA_BASE
  hex "VGA frame buffer base address"
  default 0x21000000

config SOC_VGA_SIZE
  hex "VGA frame buffer size"
  default 0x200000

config SOC_SPI_CTRL_BASE
  hex "SPI controller base address"
  default 0x10001000

config SOC_SPI_CTRL_SIZE
  hex "SPI controller address space size"
  default 0x1000

config SOC_XIP_FLASH_BASE
  hex "XIP Flash base address"
  default 0x30000000

config SOC_XIP_FLASH_SIZE
  hex "XIP Flash address space size"
  default 0x10000000

config SOC_PSRAM_BASE
  hex "PSRAM base address"
  default 0x80000000

config SOC_PSRAM_SIZE
  hex "PSRAM address space size"
  default 0x400000

config SOC_MROM_BASE
  hex "MROM base address"
  default 0x20000000

config SOC_MROM_SIZE
  hex "MROM address space size"
  default 0x1000

config SOC_SRAM_BASE
  hex "SRAM base address"
  default 0x0f000000

config SOC_SRAM_SIZE
  hex "SRAM address space size"
  default 0x2000

config SOC_SDRAM_BASE
  hex "SDRAM base address"
  default 0xa0000000

config SOC_SDRAM_SIZE
  hex "SDRAM address space size"
  default 0x2000000

endmenu # SoC Address Map
```
